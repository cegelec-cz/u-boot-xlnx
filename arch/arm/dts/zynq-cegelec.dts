/*
 * CAUTION: This file is automatically generated by Xilinx.
 * Version: XSCT 2020.1
 * Today is: Wed Nov 22 17:29:28 2023
 */


/dts-v1/;
#include "zynq-7000-ceg.dtsi"
#include "pcw.dtsi"
/ {
	chosen {
		bootargs = "earlycon";
		stdout-path = "serial0:115200n8";
	};
	aliases {
		ethernet0 = &gem0;
		serial0 = &uart1;
		spi0 = &qspi;
	};
	memory {
		device_type = "memory";
		reg = <0x0 0x40000000>;
	};
};
